## apps_digikey/03_demo_RND_kconfig/build/Kconfig/Kconfig.sysbuild.modules
```kconfig
config ZEPHYR_CMSIS_MODULE
   bool
   default y
config ZEPHYR_CMSIS_6_MODULE
   bool
   default y
config ZEPHYR_HAL_RPI_PICO_MODULE
   bool
   default y
config ZEPHYR_SAY_HELLO_MODULE
   bool
   default y
```

## apps_digikey/06_demo_device_driver/build/Kconfig/Kconfig.modules
```kconfig
menu "cmsis (/home/ezhil/embedded/zephyr_workspace/modules/hal/cmsis)"
osource "$(ZEPHYR_CMSIS_KCONFIG)"
config ZEPHYR_CMSIS_MODULE
	bool
	default y
endmenu
menu "cmsis_6 (/home/ezhil/embedded/zephyr_workspace/modules/hal/cmsis_6)"
osource "$(ZEPHYR_CMSIS_6_KCONFIG)"
config ZEPHYR_CMSIS_6_MODULE
	bool
	default y
endmenu
menu "hal_rpi_pico (/home/ezhil/embedded/zephyr_workspace/modules/hal/rpi_pico)"
osource "$(ZEPHYR_HAL_RPI_PICO_KCONFIG)"
config ZEPHYR_HAL_RPI_PICO_MODULE
	bool
	default y
endmenu
menu "button (/home/ezhil/embedded/zephyr_workspace/apps/06_demo_device_driver/../../modules/button)"
osource "/home/ezhil/embedded/zephyr_workspace/modules/button/Kconfig"
config ZEPHYR_BUTTON_MODULE
	bool
	default y
endmenu
```

## apps_nordic_academy/03_gpio_button_irq/build/Kconfig/arch/Kconfig
```kconfig
# Load Zephyr Arch Kconfig descriptions.
osource "/home/ezhil/embedded/zephyr_workspace/zephyr/arch/rx/Kconfig"
osource "/home/ezhil/embedded/zephyr_workspace/zephyr/arch/x86/Kconfig"
osource "/home/ezhil/embedded/zephyr_workspace/zephyr/arch/xtensa/Kconfig"
osource "/home/ezhil/embedded/zephyr_workspace/zephyr/arch/sparc/Kconfig"
osource "/home/ezhil/embedded/zephyr_workspace/zephyr/arch/riscv/Kconfig"
osource "/home/ezhil/embedded/zephyr_workspace/zephyr/arch/posix/Kconfig"
osource "/home/ezhil/embedded/zephyr_workspace/zephyr/arch/mips/Kconfig"
osource "/home/ezhil/embedded/zephyr_workspace/zephyr/arch/arm64/Kconfig"
osource "/home/ezhil/embedded/zephyr_workspace/zephyr/arch/arm/Kconfig"
osource "/home/ezhil/embedded/zephyr_workspace/zephyr/arch/arc/Kconfig"
```

## apps_nordic_academy/04_printk/build/Kconfig/Kconfig.modules
```kconfig
menu "cmsis (/home/ezhil/embedded/zephyr_workspace/modules/hal/cmsis)"
osource "$(ZEPHYR_CMSIS_KCONFIG)"
config ZEPHYR_CMSIS_MODULE
	bool
	default y
endmenu
menu "cmsis_6 (/home/ezhil/embedded/zephyr_workspace/modules/hal/cmsis_6)"
osource "$(ZEPHYR_CMSIS_6_KCONFIG)"
config ZEPHYR_CMSIS_6_MODULE
	bool
	default y
endmenu
menu "hal_rpi_pico (/home/ezhil/embedded/zephyr_workspace/modules/hal/rpi_pico)"
osource "$(ZEPHYR_HAL_RPI_PICO_KCONFIG)"
config ZEPHYR_HAL_RPI_PICO_MODULE
	bool
	default y
endmenu
```

## apps_nordic_academy/04_printk/build/Kconfig/boards/Kconfig.defconfig
```kconfig
# Load Zephyr board defconfig descriptions.
osource "/home/ezhil/embedded/zephyr_workspace/zephyr/boards/raspberrypi/rpi_pico/Kconfig.defconfig"
```

## apps_nordic_academy/05_logger/boards/rpi_pico.conf
```kconfig
CONFIG_SERIAL=y
CONFIG_UART_CONSOLE=y
CONFIG_CONSOLE=y


# Optional: bridge printk calls to logger
CONFIG_LOG_PRINTK=y

CONFIG_LOG=y
CONFIG_LOG_DEFAULT_LEVEL=4
CONFIG_LOG_MODE_IMMEDIATE=y
```

## apps_nordic_academy/06_uart_polling/build/Kconfig/boards/Kconfig.tmp
```kconfig
# Load Zephyr board Kconfig descriptions.
osource "/home/ezhil/embedded/zephyr_workspace/zephyr/boards/raspberrypi/rpi_pico/Kconfig"
```

## apps_nordic_academy/07_i2c/boards/rpi_pico.conf
```kconfig
# Enable generic I2C API
CONFIG_I2C=y

# Optional – better debug output
CONFIG_LOG=y
CONFIG_LOG_DEFAULT_LEVEL=3
CONFIG_LOG_MODE_DEFERRED=y

# Optional: bridge printk calls to logger
CONFIG_LOG_PRINTK=y
```

## manifest/west.yml
```yaml
manifest:
  remotes:
    - name: zephyrproject-rtos
      url-base: https://github.com/zephyrproject-rtos
  projects:
    - name: zephyr
      remote: zephyrproject-rtos
      repo-path: zephyr
      revision: main
      path: zephyr
      import:
        name-allowlist:
          - hal_rpi_pico     # Required for RP2040 support
          - cmsis            # Cortex-M core support
          - cmsis_6          
  self:
    path: manifest
```
